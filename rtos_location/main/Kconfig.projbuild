## rtos_location/main/Kconfig.projbuild
```kconfig
menu "Example Configuration"

config WIFI_SSID
    string "WiFi SSID"
    default "LJCG3"
    help
        SSID (network name) for the example to connect to.

config WIFI_PASSWORD
    string "WiFi Password"
    default "87619099"
    help
        WiFi password (WPA or WPA2) for the example to use.

        Can be left blank if the network has no security set.

menu "OTA Server Configuration"

	config CONNECT_ORIGINAL_AP
		bool "Connect to the original AP"
		default n
		help
			Connect to the original AP of old SDK

	config SERVER_IP
		string "HTTP Server IP"
		default "192.168.1.23"
		help
			HTTP Server IP to download the image file from.
			See example README.md for details.

	config SERVER_PORT
		string "HTTP Server Port"
		default "80"
		help
			HTTP Server port to connect to.
			Should be chosen not to conflict with any other port used
			on the system.

	config EXAMPLE_FILENAME
		string "HTTP GET Filename"
		default "/sniffer.bin"
		help
			Filename of the app image file to download for
			the OTA update.

endmenu

endmenu
```

## rtos_location/sdkconfig.defaults
```kconfig
#
# Serial flasher config
#
CONFIG_ESPTOOLPY_FLASHSIZE_2MB=y

#
# Partition Table
#
CONFIG_PARTITION_TABLE_CUSTOM=y
CONFIG_PARTITION_TABLE_CUSTOM_FILENAME="partitions_two_ota_v2tov3.2MB.csv"
CONFIG_PARTITION_TABLE_OFFSET=0x8000
CONFIG_PARTITION_TABLE_FILENAME="partitions_two_ota_v2tov3.2MB.csv"


#
# ESP8266-specific
#
CONFIG_ESP8266_OTA_FROM_OLD=y
```

## rtos_location_bak/main/Kconfig.projbuild
```kconfig
menu "Example Configuration"

config WIFI_SSID
    string "WiFi SSID"
    default "LJCG3"
    help
        SSID (network name) for the example to connect to.

config WIFI_PASSWORD
    string "WiFi Password"
    default "87619099"
    help
        WiFi password (WPA or WPA2) for the example to use.

        Can be left blank if the network has no security set.

endmenu
```

## rtos_scansnifferSend/main/Kconfig.projbuild
```kconfig
menu "WAYZ Configuration"

menu "WIFI Configuration"
	config ESP_WIFI_SSID
		string "WiFi SSID"
		default "Wayz Public Device"
		help
		SSID (network name) for the example to connect to.

	config ESP_WIFI_PASSWORD
		string "WiFi Password"
		default "wayz2020"
		help
		WiFi password (WPA or WPA2) for the example to use.
			
	config MAX_STA_CONN
		int "Max STA conn"
		default 4
		help
		Max number of the STA connects to AP.

	config CHANNEL
		int "Channel"
		range 1 13
		default 1
endmenu

menu "Updata Server Configuration"
	config UPDATA_SERVER_IP
		string "updata Server IP"
		default "52.82.44.25"
		help
			HTTP Server IP to download the image file from.
			See example README.md for details.

	config UPDATA_SERVER_PORT
		int "updata Server IP"
		default 26200
		help
			HTTP Server IP to download the image file from.
			See example README.md for details.
endmenu

menu "OTA Server Configuration"

	config CONNECT_ORIGINAL_AP
		bool "Connect to the original AP"
		default n
		help
			Connect to the original AP of old SDK

	config SERVER_IP
		string "HTTP Server IP"
		default "52.82.44.25"
		help
			HTTP Server IP to download the image file from.
			See example README.md for details.

	config SERVER_PORT
		string "HTTP Server Port"
		default "9090"
		help
			HTTP Server port to connect to.
			Should be chosen not to conflict with any other port used
			on the system.

	config EXAMPLE_FILENAME
		string "HTTP GET Filename"
		default "rtos_scansnifferSend.bin"
		help
			Filename of the app image file to download for
			the OTA update.

endmenu

endmenu
```

## rtos_scansnifferSend_bak/main/Kconfig.projbuild
```kconfig
menu "Example Configuration"

config ESP_WIFI_SSID
    string "WiFi SSID"
    default "Wayz Public Device"
    help
	SSID (network name) for the example to connect to.

config ESP_WIFI_PASSWORD
    string "WiFi Password"
    default "wayz2020"
    help
	WiFi password (WPA or WPA2) for the example to use.
		
config MAX_STA_CONN
    int "Max STA conn"
    default 4
    help
	Max number of the STA connects to AP.

config CHANNEL
    int "Channel"
    range 1 13
    default 1

config FILTER_MASK_MGMT
    bool "Receive management packets"
    default y

config FILTER_MASK_CTRL
    bool "Receive ctrl packets"
    default n

config FILTER_MASK_DATA
    bool "Receive data packets"
    default n

config FILTER_MASK_DATA_FRAME_PAYLOAD
    depends on FILTER_MASK_DATA
    bool "Receive data frame payload"
    default n
    help
        Select this option to enable recv data frame payload

config FILTER_MASK_MISC
    bool "Receive misc packets"
    default n

endmenu
```

## rtos_sniffer_lora/main/Kconfig.projbuild
```kconfig
menu "Example Configuration"

config CHANNEL
    int "Channel"
    range 1 13
    default 1

config FILTER_MASK_MGMT
    bool "Receive management packets"
    default y

config FILTER_MASK_CTRL
    bool "Receive ctrl packets"
    default n

config FILTER_MASK_DATA
    bool "Receive data packets"
    default n

config FILTER_MASK_DATA_FRAME_PAYLOAD
    depends on FILTER_MASK_DATA
    bool "Receive data frame payload"
    default n
    help
        Select this option to enable recv data frame payload

config FILTER_MASK_MISC
    bool "Receive misc packets"
    default n

	choice ESP_POWER_SAVE_MODE
        prompt "power save mode"
        default EXAMPLE_POWER_SAVE_MIN_MODEM
        help
            Power save mode for the esp8266 to use. Modem sleep mode includes minimum and maximum power save modes.
            In minimum/maximum power save mode, station wakes up every DTIM to receive beacon. Broadcast data will not be
            lost because it is transmitted after DTIM. However, it can not save much more power if DTIM is short
            for DTIM is determined by AP.

        config EXAMPLE_POWER_SAVE_NONE
            bool "none"
        config EXAMPLE_POWER_SAVE_MIN_MODEM
            bool "minimum modem"
        config EXAMPLE_POWER_SAVE_MAX_MODEM
            bool "maximum modem"
    endchoice

endmenu
```
